## EmbeddedSystems/Compilers/yocto-workspace/meta-compilers-demo/conf/layer.conf
```bitbake
# We have a conf and classes directory, add to BBPATH
BBPATH .= ":${LAYERDIR}"

# We have recipes-* directories, add to BBFILES
BBFILES += "${LAYERDIR}/recipes-*/*/*.bb \
           ${LAYERDIR}/recipes-*/*/*.bbappend"

BBFILE_COLLECTIONS += "meta-compilers-demo"
BBFILE_PATTERN_meta-compilers-demo = "^${LAYERDIR}/"
BBFILE_PRIORITY_meta-compilers-demo = "6"

LAYERVERSION_meta-compilers-demo = "1"
LAYERSERIES_COMPAT_meta-compilers-demo = "kirkstone langdale mickledore nanbield scarthgap styhead"

# Layer dependencies
LAYERDEPENDS_meta-compilers-demo = "core"
```
